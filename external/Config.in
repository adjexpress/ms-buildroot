## external/package/Config.in
```kconfig
menu "Mesbah Tools"
    source "$BR2_EXTERNAL_mesbah_qemu_PATH/package/python3-pkg/Config.in"
    source "$BR2_EXTERNAL_mesbah_qemu_PATH/package/python/Config.in"
    source "$BR2_EXTERNAL_mesbah_qemu_PATH/package/usbip/Config.in"
    source "$BR2_EXTERNAL_mesbah_qemu_PATH/package/mesbah_agent/Config.in"
    source "$BR2_EXTERNAL_mesbah_qemu_PATH/package/teegriskdf/Config.in"
    source "$BR2_EXTERNAL_mesbah_qemu_PATH/package/metadata_decrypt/Config.in"
endmenu
```

## external/package/fscrypt_keyutil/Config.in
```kconfig
config BR2_PACKAGE_FSCRYPT_KEYUTIL
	bool"fscrypt_keyutil"
	select BR2_PACKAGE_KEYUTILS
	help
	  fscrypt keyutil
```

## external/package/mesbah_agent/Config.in
```kconfig
config BR2_PACKAGE_MESBAH_AGENT
	bool"mesbah_agent"
	depends on BR2_PACKAGE_LIBOPENSSL
	help
	  mesbah on device agent (server)
comment "mesbah_agent requires openssl"
	depends on !BR2_PACKAGE_LIBOPENSSL
```

## external/package/metadata_decrypt/Config.in
```kconfig
config BR2_PACKAGE_METADATA_DECRYPT
	bool"metadata_decrypt"
	help
	  metadata_decrypt
```

## external/package/python3-pkg/Config.in
```kconfig
# config BR2_PACKAGE_QT5_SINGLE
# 	bool "qt5_single"
# 	depends on BR2_INSTALL_LIBSTDCPP
# 	depends on BR2_USE_WCHAR
# 	depends on BR2_TOOLCHAIN_HAS_THREADS_NPTL
# 	depends on BR2_HOST_GCC_AT_LEAST_5 # Full C++11
# 	depends on BR2_TOOLCHAIN_GCC_AT_LEAST_5 # C++11, GCC_BUG_57694
# 	depends on !BR2_ARM_CPU_ARMV4 # needs ARMv5+
# 	select BR2_PACKAGE_ZLIB
# 	select BR2_PACKAGE_PCRE2
# 	select BR2_PACKAGE_PCRE2_16
# 	select BR2_PACKAGE_LIBOPENSSL_ENABLE_PSK if BR2_PACKAGE_LIBOPENSSL
# 	help
# 	  Qt is a cross-platform application and UI framework for
# 	  developers using C++.
# 	  
# 	  This option enables the Qt5 qt5base module, which
# 	  contains the base Qt libraries: QtCore, QtNetwork, QtGui,
# 	  QtWidgets, etc.. Sub-options allow to
# 	  select which modules should be built.
# 
# 	  https://qt.io

# if BR2_PACKAGE_QT5_SINGLE

# 		config BR2_PACKAGE_QT5_SINGLE_CUSTOM_CONF_OPTS
# 			string "Custom configuration options"
# 			help
# 			Define custom qt5 configuration options which can be used to
# 			enable or disable options not managed by buildroot. These
# 			options are appended to the ones generated by buildroot and
# 			passed to qt5base during configuration.
# 
# 			E.g. to remove the Windows Vista style option, add the option
# 			-no-feature-style_windowsvista.

		source "$BR2_EXTERNAL_mesbah_qemu_PATH/package/python3-pkg/python-capstone/Config.in"
		source "$BR2_EXTERNAL_mesbah_qemu_PATH/package/python3-pkg/python-fusepy/Config.in"
		source "$BR2_EXTERNAL_mesbah_qemu_PATH/package/python3-pkg/python-keystone-engine/Config.in"
		source "$BR2_EXTERNAL_mesbah_qemu_PATH/package/python3-pkg/python-mock/Config.in"
		source "$BR2_EXTERNAL_mesbah_qemu_PATH/package/python3-pkg/python-pycryptodome/Config.in"
		source "$BR2_EXTERNAL_mesbah_qemu_PATH/package/python3-pkg/python-pyserial/Config.in"

# endif
```

## external/package/python3-pkg/python-capstone/Config.in
```kconfig
config BR2_PACKAGE_PYTHON_CAPSTONE
	bool "python-capstone"
	depends on BR2_PACKAGE_PYTHON3
	help
	  Capstone is a disassembly framework with the target of becoming the ultimate disasm engine for binary analysis and reversing in the security community.

	  https://www.capstone-engine.org/
```

## external/package/python3-pkg/python-fusepy/Config.in
```kconfig
config BR2_PACKAGE_PYTHON_FUSEPY
	bool "python-fusepy"
	depends on BR2_PACKAGE_PYTHON3
	select BR2_PACKAGE_LIBFUSE
	help
	  fusepy is a Python module that provides a simple interface to FUSE and MacFUSE. It’s just one file and is implemented using ctypes.

	  http://github.com/fusepy/fusepy
```

## external/package/python3-pkg/python-keystone-engine/Config.in
```kconfig
config BR2_PACKAGE_PYTHON_KEYSTONE_ENGINE
	bool "python-keystone-engine"
	depends on BR2_PACKAGE_PYTHON3
# 	depends on BR2_PACKAGE_HOST_PYTHON
	
	help
	  Keystone is a lightweight multi-platform, multi-architecture assembler framework. It offers some unparalleled features:

	  https://www.keystone-engine.org/
```

## external/package/python3-pkg/python-mtkclient/Config.in
```kconfig
config BR2_PACKAGE_PYTHON_MTKCLIENT
	bool "python-mtkclient"
	depends on BR2_PACKAGE_PYTHON3
	select BR2_PACKAGE_PYTHON_PYUSB
	select BR2_PACKAGE_PYTHON_FUSEPY
	select BR2_PACKAGE_PYTHON_PYCRYPTODOMEX
	select BR2_PACKAGE_PYTHON_COLORAMA
	select BR2_PACKAGE_PYTHON_MOCK
	select BR2_PACKAGE_PYTHON_PYSERIAL
	select BR2_PACKAGE_PYTHON_CRYPTODOME
	select BR2_PACKAGE_PYTHON_CAPSTONE
	help
	  fusepy is a Python module that provides a simple interface to FUSE and MacFUSE. It’s just one file and is implemented using ctypes.

	  http://github.com/fusepy/fusepy
```

## external/package/python3-pkg/python-pycryptodome/Config.in
```kconfig
config BR2_PACKAGE_PYTHON_CRYPTODOME
	bool "python-pycryptodome"
	depends on BR2_PACKAGE_PYTHON3
	help
	  PyCryptodome is a self-contained Python package of low-level cryptographic primitives.

	  https://www.pycryptodome.org/
```

## external/package/python3-pkg/python-pyserial/Config.in
```kconfig
config BR2_PACKAGE_PYTHON_PYSERIAL
	bool "python-pyserial"
	depends on BR2_PACKAGE_PYTHON3
	help
	  mock is a library for testing in Python. It allows you to replace parts of your system under test with mock objects and make assertions about how they have been used.

	  https://github.com/testing-cabal/mock
```

## external/package/teegriskdf/Config.in
```kconfig
config BR2_PACKAGE_TEEGRISKDF
	bool"teegriskdf"
	depends on BR2_PACKAGE_LIBOPENSSL
	help
	  teegriskdf
comment "teegriskdf requires openssl"
	depends on !BR2_PACKAGE_LIBOPENSSL
```

## external/package/usbip/Config.in
```kconfig
config BR2_PACKAGE_USBIP
	bool"usbip"
	help
	  usbip is a set of tools that allows machines to share their
	  usb devices over the network, to be driven by a remote client.
comment "usbip requires a toolchain with WCHAR support"
        depends on !BR2_USE_WCHAR

if BR2_PACKAGE_USBIP

config BR2_USBIP_CLIENT
	bool "usbip client"
	default y
	help
	  the client part of usbip

config BR2_USBIP_SERVER
	bool "usbip server"
	help
	  the server part of usbip

endif
```
